## 67030298/Lab11-4_RainMaker_Light/sdkconfig.defaults
```kconfig
CONFIG_ESPTOOLPY_FLASHSIZE_4MB=y
CONFIG_PARTITION_TABLE_CUSTOM=y
CONFIG_PARTITION_TABLE_CUSTOM_FILENAME="partitions.csv"
CONFIG_PARTITION_TABLE_FILENAME="partitions.csv"
CONFIG_APP_NETWORK_PROV_TRANSPORT_BLE=y
CONFIG_APP_NETWORK_PROV_TRANSPORT_SOFTAP=n
CONFIG_APP_NETWORK_PROV_SHOW_QR=y
```

## 67030351/Lab11-4_RainMaker_Light/sdkconfig.defaults
```kconfig
CONFIG_ESPTOOLPY_FLASHSIZE_4MB=y
CONFIG_ESPTOOLPY_FLASHSIZE="4MB"
CONFIG_PARTITION_TABLE_CUSTOM=y
CONFIG_PARTITION_TABLE_CUSTOM_FILENAME="partitions.csv"
CONFIG_PARTITION_TABLE_FILENAME="partitions.csv"
CONFIG_BT_BTC_TASK_STACK_SIZE=8192
CONFIG_BTC_TASK_STACK_SIZE=8192
CONFIG_BT_BTU_TASK_STACK_SIZE=6144
CONFIG_BTU_TASK_STACK_SIZE=6144
CONFIG_ESP_MAIN_TASK_STACK_SIZE=7168
```

## Example_project/Lab11-2_MQTT_Client/main/Kconfig.projbuild
```kconfig
menu "Lab11 MQTT Client Configuration"

config LAB_WIFI_SSID
    string "Wi-Fi SSID"
    default ""
    help
        SSID of the 2.4 GHz Wi-Fi network used by the ESP32.

config LAB_WIFI_PASSWORD
    string "Wi-Fi password"
    default ""
    help
        Password for the Wi-Fi network. This value is stored in the local sdkconfig file.

config LAB_MQTT_BROKER_URI
    string "MQTT broker URI"
    default "mqtt://172.20.10.3:1884"
    help
        MQTT URI reachable by the ESP32, for example mqtt://192.168.1.100:1884.

endmenu
```

## Example_project/Lab11-3_MQTTS_Secure/main/Kconfig.projbuild
```kconfig
menu "Lab11-3 Secure MQTT Configuration"

config LAB_WIFI_SSID
    string "Wi-Fi SSID"
    default ""

config LAB_WIFI_PASSWORD
    string "Wi-Fi password"
    default ""

config LAB_MQTTS_BROKER_URI
    string "MQTTS broker URI"
    default "mqtts://172.20.10.3:8883"

endmenu
```

## Example_project/Lab11-4_RainMaker_Light/main/Kconfig.projbuild
```kconfig
menu "RainMaker Light Configuration"

    config APP_LIGHT_INITIAL_BRIGHTNESS
        int "Initial LED brightness"
        range 0 100
        default 100
        help
            Initial brightness for the LED and RainMaker Brightness parameter.

endmenu
```

## Lab11-4_RainMaker_Light/sdkconfig.defaults
```kconfig
CONFIG_ESP_RMAKER_NETWORK_OVER_WIFI=y
CONFIG_APP_NETWORK_PROV_TRANSPORT_BLE=y
CONFIG_APP_PROV_SECURITY_VERSION_2=y
CONFIG_BT_ENABLED=y
CONFIG_BT_NIMBLE_ENABLED=y
```
